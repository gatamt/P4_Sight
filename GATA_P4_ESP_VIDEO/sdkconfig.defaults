## GATA_P4_ESP_VIDEO/sdkconfig.defaults
```kconfig
CONFIG_IDF_TARGET="esp32p4"
CONFIG_ESP32P4_REV_MIN_FULL=100
CONFIG_IDF_EXPERIMENTAL_FEATURES=y

CONFIG_SPIRAM=y
CONFIG_SPIRAM_MODE_HEX=y
CONFIG_SPIRAM_SPEED_200M=y
CONFIG_SPIRAM_BOOT_INIT=y
CONFIG_SPIRAM_USE_MALLOC=y
CONFIG_SPIRAM_MALLOC_ALWAYSINTERNAL=4096
CONFIG_SPIRAM_MALLOC_RESERVE_INTERNAL=32768
CONFIG_SPIRAM_XIP_FROM_PSRAM=y

CONFIG_CACHE_L2_CACHE_256KB=y
CONFIG_CACHE_L2_CACHE_LINE_128B=y

CONFIG_ESPTOOLPY_FLASHSIZE_16MB=y
CONFIG_ESPTOOLPY_FLASHSIZE="16MB"
CONFIG_PARTITION_TABLE_CUSTOM=y
CONFIG_PARTITION_TABLE_CUSTOM_FILENAME="partitions.csv"
CONFIG_ESPTOOLPY_FLASHMODE_QIO=y
CONFIG_ESP_DEFAULT_CPU_FREQ_MHZ_360=y
CONFIG_ESP_DEFAULT_CPU_FREQ_MHZ=360
CONFIG_COMPILER_OPTIMIZATION_PERF=y
CONFIG_ESP_MAIN_TASK_STACK_SIZE=8192

CONFIG_ESP_VIDEO_ENABLE_MIPI_CSI_VIDEO_DEVICE=y
CONFIG_ESP_VIDEO_DISABLE_MIPI_CSI_DRIVER_BACKUP_BUFFER=y
CONFIG_ESP_VIDEO_ENABLE_ISP_VIDEO_DEVICE=y
CONFIG_ESP_VIDEO_ENABLE_ISP_PIPELINE_CONTROLLER=y
CONFIG_ISP_PIPELINE_CONTROLLER_TASK_STACK_USE_PSRAM=y
CONFIG_ESP_VIDEO_ENABLE_SWAP_SHORT=y
CONFIG_ESP_VIDEO_ENABLE_SWAP_SHORT_RISCV=y
CONFIG_ESP_VIDEO_ENABLE_DVP_VIDEO_DEVICE=n
CONFIG_ESP_VIDEO_ENABLE_HW_H264_VIDEO_DEVICE=y
CONFIG_ESP_VIDEO_ENABLE_HW_JPEG_VIDEO_DEVICE=y

CONFIG_CAM_CTLR_MIPI_CSI_ISR_IRAM_SAFE=y
CONFIG_ISP_CTRL_FUNC_IN_IRAM=y

CONFIG_CAMERA_IMX708=y
CONFIG_CAMERA_IMX708_AUTO_DETECT_MIPI_INTERFACE_SENSOR=y
CONFIG_CAMERA_IMX708_MIPI_RAW10_1280X720_60FPS=y
CONFIG_CAMERA_IMX708_MIPI_LINK_FREQ_450MHZ=y
CONFIG_CAMERA_IMX708_QBC_ADJUST=2
CONFIG_CAMERA_IMX708_ENABLE_PDAF=y
CONFIG_CAMERA_IMX708_EXPOSURE_MIN_MS=1
CONFIG_CAMERA_IMX708_EXPOSURE_MAX_MS=60

CONFIG_CAMERA_XCLK_USE_ESP_CLOCK_ROUTER=y
CONFIG_CAM_MOTOR_DW9807=y
CONFIG_CAM_MOTOR_DW9807_AUTO_DETECT=y
CONFIG_ESP_VIDEO_ENABLE_CAMERA_MOTOR_CONTROLLER=y
CONFIG_ESP_VIDEO_ISP_PIPELINE_CONTROL_CAMERA_MOTOR=y

CONFIG_VFS_SUPPORT_IO=y
CONFIG_VFS_MAX_COUNT=16
CONFIG_FATFS_LFN_HEAP=y
CONFIG_FATFS_VFS_FSTAT_BLKSIZE=4096

CONFIG_FREERTOS_HZ=1000
CONFIG_FREERTOS_TIMER_TASK_STACK_DEPTH=3072
CONFIG_FREERTOS_ISR_STACKSIZE=2048
CONFIG_FREERTOS_WATCHPOINT_END_OF_STACK=y
CONFIG_FREERTOS_CHECK_STACKOVERFLOW_CANARY=y
CONFIG_ESP_TASK_WDT_EN=n
CONFIG_COMPILER_STACK_CHECK_MODE_NORM=y

CONFIG_LOG_DEFAULT_LEVEL_INFO=y
CONFIG_LOG_MAXIMUM_LEVEL_INFO=y
```
